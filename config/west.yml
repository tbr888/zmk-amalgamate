## config/west.yml
```yaml
manifest:
  remotes:
    - name: zmkfirmware
      url-base: https://github.com/stephen/
    - name: anthonyamanse
      url-base: https://github.com/AnthonyAmanse
  projects:
    - name: zmk
      remote: anthonyamanse
      revision: AnthonyAmanse-zmk-v2.4.0+inkdriver
      import: app/west.yml
  self:
    path: config
```
